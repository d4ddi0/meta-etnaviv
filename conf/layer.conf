## conf/layer.conf
```bitbake
# We have a conf and classes directory, add to BBPATH
BBPATH .= ":${LAYERDIR}"

# We have recipes-* directories, add to BBFILES
BBFILES += "${LAYERDIR}/recipes-*/*/*.bb \
            ${LAYERDIR}/recipes-*/*/*.bbappend"

BBFILE_COLLECTIONS += "etnaviv"
BBFILE_PATTERN_etnaviv = "^${LAYERDIR}/"
BBFILE_PRIORITY_etnaviv = "5"
LAYERVERSION_etnaviv = "1"
```
